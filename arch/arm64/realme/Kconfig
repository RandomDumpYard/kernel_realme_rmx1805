## arch/arm64/realme/Kconfig
```kconfig
menu "Realme product selection"

config PRODUCT_REALME
	bool "Realme devices"
	help
	  This enables support for Realme devices.

if PRODUCT_REALME

config PRODUCT_REALME_SDM450
	bool "Realme SDM450-Common"

choice
	prompt "Realme device"

config PRODUCT_REALME_RMX1805
	bool "Realme 2"
	select PRODUCT_REALME_SDM450
	help
	  This enables support for Realme 2.

endchoice

endif

endmenu
```

## drivers/soc/oppo/oppo_healthinfo/Kconfig
```kconfig
#ifdef CONFIG_PRODUCT_REALME_RMX1805
config OPPO_HEALTHINFO
bool "config oppo healthinfo"
help
    define this config to init oppo healthinfo.
#endif /* CONFIG_PRODUCT_REALME_RMX1805 */
```

## drivers/soc/oppo/oppo_phoenix/Kconfig
```kconfig
# ifdef CONFIG_PRODUCT_REALME_RMX1805
#//Kun.Hu@PSW.TECH 2018/11/15, Add phoenix base
config PHOENIX_BASE
bool "config phoenix base"
help
    Provide base functions for phoenix.
#endif /* CONFIG_PRODUCT_REALME_RMX1805 */
```
